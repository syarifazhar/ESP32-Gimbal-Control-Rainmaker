## main/Kconfig.projbuild
```kconfig
menu "PanTilt Example Configuration"

    config EXAMPLE_BOARD_BUTTON_GPIO
        int "Boot Button GPIO"
        default 9 if IDF_TARGET_ESP32C3 || IDF_TARGET_ESP32C6 || \
                IDF_TARGET_ESP32C2 || IDF_TARGET_ESP32H2
        default 0
        help
            GPIO number on which the "Boot" button is connected.

    config EXAMPLE_OUTPUT_GPIO_RED
        int "Red GPIO"
        default 2
        help
            GPIO for the red channel of the RGB LED.

    config EXAMPLE_OUTPUT_GPIO_GREEN
        int "Green GPIO"
        default 4
        help
            GPIO for the green channel of the RGB LED.

    config EXAMPLE_OUTPUT_GPIO_BLUE
        int "Blue GPIO"
        default 5
        help
            GPIO for the blue channel of the RGB LED.

    config PAN_M1A_GPIO
        int "Pan Motor M1A GPIO"
        default 12
        help
            GPIO driving the M1A input of the pan motor.

    config PAN_M1B_GPIO
        int "Pan Motor M1B GPIO"
        default 13
        help
            GPIO driving the M1B input of the pan motor.

    config TILT_M1A_GPIO
        int "Tilt Motor M1A GPIO"
        default 10
        help
            GPIO driving the M1A input of the tilt motor.

    config TILT_M1B_GPIO
        int "Tilt Motor M1B GPIO"
        default 11
        help
            GPIO driving the M1B input of the tilt motor.

    config IR_LEFT_GPIO
        int "IR Left Sensor GPIO"
        default 1
        help
            GPIO for the left IR sensor input (active low).

    config IR_RIGHT_GPIO
        int "IR Right Sensor GPIO"
        default 0
        help
            GPIO for the right IR sensor input (active low).

    config SERVO_GPIO
        int "Servo Control GPIO"
        default 8
        help
            GPIO output for the servo PWM signal.

endmenu
```
